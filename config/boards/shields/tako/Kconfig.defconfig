## config/boards/shields/tako/Kconfig.defconfig
```kconfig
if SHIELD_TAKO_LEFT

config ZMK_KEYBOARD_NAME
  default "Tako"

config ZMK_SPLIT_ROLE_CENTRAL
  default y

endif

if SHIELD_TAKO_LEFT || SHIELD_TAKO_RIGHT

config ZMK_SPLIT
  default y

config I2C
    default n

endif
```

## config/boards/shields/tako/Kconfig.shield
```kconfig
config SHIELD_TAKO_LEFT
  def_bool $(shields_list_contains,tako_left)

config SHIELD_TAKO_RIGHT
  def_bool $(shields_list_contains,tako_right)
```

## config/dts/bindings/kscan/zmk,kscan-gpio-ec.yml
```yaml
# Copyright (c) 2023 The ZMK Contributors
# SPDX-License-Identifier: MIT

description: EC keyboard matrix controller

compatible: "zmk,kscan-gpio-ec"

include: kscan.yaml

properties:
  row-gpios:
    type: phandle-array
    required: true
  mux-sel-gpios:
    type: phandle-array
    required: true
  mux-en-gpios:
    type: phandle-array
    required: true
  discharge-gpios:
    type: phandle-array
    required: true
  io-channels:
    type: phandle-array
    required: true
  col-channels:
    type: array
    required: true
  poll-period-ms:
    type: int
    default: 10
    description: Time between reads in milliseconds.
  idle-poll-period-ms:
    type: int
    default: 30
  sleep-poll-period-ms:
    type: int
    default: 3000
  muxes:
    type: phandle-array
  power-gpios:
    type: phandle-array
    required: true
```

## config/tako_drivers/kscan/Kconfig
```kconfig
# Copyright (c) 2023 Sviatoslav Bulbakha
# SPDX-License-Identifier: MIT

DT_COMPAT_ZMK_KSCAN_GPIO_EC := zmk,kscan-gpio-ec

config ZMK_KSCAN_GPIO_EC
    bool
    default $(dt_compat_enabled,$(DT_COMPAT_ZMK_KSCAN_GPIO_EC))
    select ZMK_KSCAN_GPIO_DRIVER
    select ADC
```
